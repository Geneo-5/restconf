## Config.in
```kconfig
################################################################################
# SPDX-License-Identifier: LGPL-3.0-only
#
# This file is part of restconf.
# Copyright (C) 2026 Loic JOURDHEUIL SELLIN
################################################################################

config RESTCONF_ASSERT
	bool "Enable internal assertions"
	default n
	help
	  Enable internal consistency assertions (rest_assert()) throughout the
	  restconf codebase.

	  When disabled (default), assertions are compiled out and have no
	  runtime cost, but also no defensive checks. Meant to be enabled while
	  developing/debugging or in CI builds, and disabled in production
	  builds.

	  Disables -DNDEBUG when enabled.

config RESTCONF_DEBUG
	bool "Enable debug mode"
	default n
	help
	  Enable debug mode. Daemon not redirect stdout to /dev/null.

config RESTCONF_DEBUG_SYSREPO
	bool "Enable sysrepo trace"
	depends on RESTCONF_DEBUG
	default n
	help
	  Enable sysrepo trace to stderr.

config YANG_PATH
	string "Path to the YANG modules directory"
	default "/usr/share/yang/modules"
	help
	  Filesystem path where the YANG modules used by the RESTCONF server
	  (and by sysrepo/libyang) are looked up.

choice
	prompt "Sysrepo integration mode"
	default SYSREPO_BUILTIN
	help
	  Select how the restconf server is wired to sysrepo:
	    - builtin to the restconfd daemon itself ;
	    - as a plugin loaded by sysrepo-plugind ;
	    - as a standalone autonomous daemon.

	config SYSREPO_PLUGIND
		bool "Sysrepo plugin, loaded by sysrepo-plugind"
		help
		  Build restconf as a shared library plugin (restconf.so) meant to
		  be loaded by an existing sysrepo-plugind instance. See
		  SYSREPO_PLUGIND_PATH for the install location.

	config SYSREPO_DAEMON
		bool "Autonomous daemon"
		help
		  Build restconf as a standalone daemon (sysrepo-restconf) that
		  manages its own sysrepo session, independently of restconfd.

	config SYSREPO_BUILTIN
		bool "Builtin to the restconf daemon"
		help
		  Build sysrepo support directly into the restconfd binary. This
		  is the simplest deployment mode: a single daemon handles both
		  the RESTCONF HTTP/2 frontend and the sysrepo session.
endchoice

config SYSREPO_PLUGIND_PATH
	string "Sysrepo plugind plugins install path"
	depends on SYSREPO_PLUGIND || RESTCONF_TEST
	default "/usr/lib/sysrepo-plugind/plugins"
	help
	  Directory where the restconf.so plugin is installed so that
	  sysrepo-plugind can discover and load it.

config H2C_MAX_REQUEST_BODY_SIZE
	int "Maximum HTTP request body size (bytes)"
	default 16777216
	help
	  Upper bound, in bytes, on the size of an HTTP/2 request body accepted
	  by the backend. Requests exceeding this limit should be rejected to
	  protect the server against oversized-payload abuse.

config H2C_MAX_CONCURRENT_STREAMS
	int "Maximum concurrent HTTP/2 streams per connection"
	default 100
	help
	  Value advertised in the HTTP/2 SETTINGS_MAX_CONCURRENT_STREAMS
	  parameter, limiting the number of streams a single client connection
	  may keep open at once (multiplexing/DoS protection).

config H2C_INITIAL_WINDOW_SIZE
	int "Initial HTTP/2 per-stream flow-control window size (bytes)"
	default 1048576
	help
	  Initial flow-control window size, in bytes, advertised for each
	  individual HTTP/2 stream.

config H2C_CONNECTION_WINDOW_SIZE
	int "HTTP/2 connection-level flow-control window size (bytes)"
	default 4194304
	help
	  Flow-control window size, in bytes, applied at the HTTP/2 connection
	  level (as opposed to the per-stream window set by
	  H2C_INITIAL_WINDOW_SIZE).

config H2C_RESTCONF_ROOT
	string "RESTCONF root resource path ({+restconf})"
	default "/restconf"
	help
	  Path at which the RESTCONF root resource ({+restconf}, as defined by
	  RFC 8040) is exposed, e.g. as advertised by the
	  /.well-known/host-meta discovery document.

choice
	prompt "JWT alog"
	default ALG_NONE
	config ALG_NONE
		bool "JWT Algo NONE"
		help
		  Use JWT with algo NONE. Use only for test.
endchoice

config JWT_GRANT_USERNAME
	string "JWT grant username"
	default "name"
	help
	  Set grant value whose store user name used for NACM.

choice
	prompt "Capability defaults mode"
	default CAPABILITY_TRIM
	config CAPABILITY_REPORT_ALL
		bool "report-all"
		help
		  No data nodes are considered default
	config CAPABILITY_TRIM
		bool "trim"
		help
		  Values set to the YANG default-stmt value are default
	config CAPABILITY_EXPLICIT
		bool "explicit"
		help
		  Values set by the client are never considered default
endchoice

config ROOT_WELL_KNOWN
	bool "Enable well known path"
	default y
	help
	  Enable '/.well-known/host-meta' path

config RESTCONF_TEST
	bool "Build RESTCONF test"
	default n
	help
	  Build the RESTCONF test plugin for sysrepo-plugind and install
	  the corresponding restconf-test.yang module.

	  Say Y here to enable the RESTCONF pytest suite. Without this
	  option, most RESTCONF tests will be skipped.

config PREFIX_RESTCONF_DATA
	bool "Prefix data answer"
	default y
	help
	  Prefix by ietf-restconf the data of request GET {+resconf}/data

config PREFIX_RESTCONF_OPERATIONS
	bool "Prefix operations answer"
	default y
	help
	  Prefix by ietf-restconf the data of request GET {+resconf}/operations
```
